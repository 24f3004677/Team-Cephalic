#include "ml_xgb_inference.h"
#include <math.h>
#include <stdint.h>

// ============================================================
// TRAINED FEATURE ORDER
// ============================================================
//
//  0  Accel_X_live
//  1  Accel_X_mean
//  2  Accel_X_std
//  3  Accel_X_max
//  4  Accel_Y_live
//  5  Accel_Y_mean
//  6  Accel_Y_std
//  7  Accel_Y_max
//  8  Accel_Z_live
//  9  Accel_Z_mean
// 10  Accel_Z_std
// 11  Accel_Z_max
// 12  Strain_live
// 13  Strain_mean
// 14  Strain_std
// 15  Strain_max
// 16  Temp_live
// 17  Temp_mean
// 18  Temp_std
// 19  Temp_max
// 20  roof_convergence_cm_live
// 21  roof_convergence_cm_mean
// 22  roof_convergence_cm_std
// 23  roof_convergence_cm_max
//
// No scaler is applied by this generated inference because the
// supplied XGBoost JSON contains raw feature split thresholds.
// ============================================================

static const uint16_t ML_TREE_OFFSETS[451] = {
    0, 3, 8, 13, 16, 21, 26, 29, 36, 41, 44, 49,
    54, 57, 64, 69, 72, 77, 82, 85, 92, 97, 100, 107,
    110, 113, 118, 123, 126, 133, 138, 141, 148, 153, 156, 163,
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    1946, 1949, 1952, 1953, 1956, 1959, 1960,
};

static const int8_t ML_LEFT[1960] = {
    1, -1, -1, 1, 3, -1, -1, -1, 1, -1, 3, -1, -1, 1, -1, -1, 1, 3, -1, -1,
    -1, 1, -1, 3, -1, -1, 1, -1, -1, 1, 3, -1, -1, 5, -1, -1, 1, -1, 3, -1,
    -1, 1, -1, -1, 1, 3, -1, -1, -1, 1, 3, -1, -1, -1, 1, -1, -1, 1, 3, -1,
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    -1, -1, 1, -1, -1, -1, 1, -1, -1, 1, -1, -1, -1, 1, -1, -1, 1, -1, -1, -1,
};

static const int8_t ML_RIGHT[1960] = {
    2, -1, -1, 2, 4, -1, -1, -1, 2, -1, 4, -1, -1, 2, -1, -1, 2, 4, -1, -1,
    -1, 2, -1, 4, -1, -1, 2, -1, -1, 2, 4, -1, -1, 6, -1, -1, 2, -1, 4, -1,
    -1, 2, -1, -1, 2, 4, -1, -1, -1, 2, 4, -1, -1, -1, 2, -1, -1, 2, 4, -1,
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    -1, -1, 2, -1, -1, -1, 2, -1, -1, 2, -1, -1, -1, 2, -1, -1, 2, -1, -1, -1,
};

static const uint8_t ML_FEATURE[1960] = {
    20, 0, 0, 20, 20, 0, 0, 0, 20, 0, 20, 0, 0, 20, 0, 0, 20, 20, 0, 0,
    0, 20, 0, 20, 0, 0, 20, 0, 0, 20, 20, 0, 0, 20, 0, 0, 20, 0, 20, 0,
    0, 20, 0, 0, 20, 20, 0, 0, 0, 20, 4, 0, 0, 0, 20, 0, 0, 20, 20, 0,
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    0, 0, 22, 0, 0, 0, 20, 0, 0, 22, 0, 0, 0, 20, 0, 0, 22, 0, 0, 0,
};

static const uint8_t ML_DEFAULT_LEFT[1960] = {
    0, 0, 0, 0, 0, 0, 0, 0, 0, 0, 0, 0, 0, 0, 0, 0, 0, 0, 0, 0,
    0, 0, 0, 0, 0, 0, 0, 0, 0, 0, 0, 0, 0, 0, 0, 0, 0, 0, 0, 0,
    0, 0, 0, 0, 0, 0, 0, 0, 0, 0, 0, 0, 0, 0, 0, 0, 0, 0, 0, 0,
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    0, 0, 0, 0, 0, 0, 0, 0, 0, 0, 0, 0, 0, 0, 0, 0, 0, 0, 0, 0,
};

static const float ML_SPLIT[1960] = {
    298.67453f, -0.08459627f, 0.03518555f, 298.67453f, 260.4422f, -0.030353678f, -0.029408393f, 0.13369155f, 260.4422f, 0.21250606f,
    281.88684f, 0.00760343f, -0.027929364f, 298.67453f, -0.07589198f, 0.03453744f, 298.67453f, 260.4422f, -0.030041162f, -0.02946431f,
    0.11320616f, 260.4422f, 0.1673327f, 281.88684f, 0.0068731657f, -0.02780795f, 298.67453f, -0.06918914f, 0.03393751f, 298.67453f,
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    0.00406404f, -0.0053691287f, 0.0010602219f, 298.67453f, -0.01280426f, 0.012756281f, 16.01205f, 0.004029676f, -0.005307165f, 0.0010324507f,
};

static const float ML_LEAF[1960] = {
    0.0f, -0.08459627f, 0.03518555f, 0.0f, 0.0f, -0.030353678f, -0.029408393f, 0.13369155f, 0.0f, 0.21250606f,
    0.0f, 0.00760343f, -0.027929364f, 0.0f, -0.07589198f, 0.03453744f, 0.0f, 0.0f, -0.030041162f, -0.02946431f,
    0.11320616f, 0.0f, 0.1673327f, 0.0f, 0.0068731657f, -0.02780795f, 0.0f, -0.06918914f, 0.03393751f, 0.0f,
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    0.00406404f, -0.0053691287f, 0.021204438f, 0.0f, -0.01280426f, 0.012756281f, 0.0f, 0.004029676f, -0.005307165f, 0.020649014f,
};

static const uint8_t ML_TREE_CLASS[ML_XGB_TREES] = {
    0, 1, 2, 0, 1, 2, 0, 1, 2, 0, 1, 2, 0, 1, 2, 0, 1, 2, 0, 1, 2, 0, 1, 2, 0, 1, 2, 0, 1, 2,
    0, 1, 2, 0, 1, 2, 0, 1, 2, 0, 1, 2, 0, 1, 2, 0, 1, 2, 0, 1, 2, 0, 1, 2, 0, 1, 2, 0, 1, 2,
    0, 1, 2, 0, 1, 2, 0, 1, 2, 0, 1, 2, 0, 1, 2, 0, 1, 2, 0, 1, 2, 0, 1, 2, 0, 1, 2, 0, 1, 2,
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    0, 1, 2, 0, 1, 2, 0, 1, 2, 0, 1, 2, 0, 1, 2, 0, 1, 2, 0, 1, 2, 0, 1, 2, 0, 1, 2, 0, 1, 2,
};

static inline float softmaxStable(float x0, float x1, float x2)
{
    (void)x0; (void)x1; (void)x2;
    return 0.0f;
}

void printMLXGBInput(const float features[ML_XGB_FEATURES])
{
    Serial.println("========== ML XGB INPUT ==========");
    for (int i = 0; i < ML_XGB_FEATURES; ++i)
        Serial.printf("ML[%02d] = %.8f\n", i, features[i]);
    Serial.println("==================================");
}

bool runMLXGB(
    const float features[ML_XGB_FEATURES],
    MLXGBResult &result)
{
    if (!features) return false;

    float margin[ML_XGB_CLASSES] = {
        1.070602f,
        -0.29125404f,
        -0.77934813f
    };

    for (int t = 0; t < ML_XGB_TREES; ++t)
    {
        const int start = ML_TREE_OFFSETS[t];
        const int end   = ML_TREE_OFFSETS[t + 1];
        int node = 0;
        float leafValue = 0.0f;

        while (true)
        {
            const int g = start + node;
            const int8_t lch = ML_LEFT[g];

            // Leaf node
            if (lch < 0)
            {
                leafValue = ML_LEAF[g];
                break;
            }

            const uint8_t f = ML_FEATURE[g];
            const float x = features[f];

            int nextNode;

            // XGBoost learned default direction for missing values.
            if (isnan(x))
            {
                nextNode = ML_DEFAULT_LEFT[g]
                         ? ML_LEFT[g]
                         : ML_RIGHT[g];
            }
            else if (x < ML_SPLIT[g])
            {
                nextNode = ML_LEFT[g];
            }
            else
            {
                nextNode = ML_RIGHT[g];
            }

            if (nextNode < 0 || start + nextNode >= end)
                return false;

            node = nextNode;
        }

        const uint8_t cls = ML_TREE_CLASS[t];
        if (cls >= ML_XGB_CLASSES)
            return false;

        margin[cls] += leafValue;
    }

    result.margin[0] = margin[0];
    result.margin[1] = margin[1];
    result.margin[2] = margin[2];

    // Exact softmax, numerically stable.
    float maxMargin = margin[0];
    if (margin[1] > maxMargin) maxMargin = margin[1];
    if (margin[2] > maxMargin) maxMargin = margin[2];

    const float e0 = expf(margin[0] - maxMargin);
    const float e1 = expf(margin[1] - maxMargin);
    const float e2 = expf(margin[2] - maxMargin);
    const float sum = e0 + e1 + e2;

    if (!(sum > 0.0f) || !isfinite(sum))
        return false;

    result.probability[0] = e0 / sum;
    result.probability[1] = e1 / sum;
    result.probability[2] = e2 / sum;

    uint8_t best = 0;
    if (result.probability[1] > result.probability[best]) best = 1;
    if (result.probability[2] > result.probability[best]) best = 2;

    result.predictionClass = best;

    return true;
}
