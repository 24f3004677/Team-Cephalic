#include "xgb_ensemble_inference.h"
#include <Arduino.h>
#include <math.h>
#include <stdint.h>

// Trained feature order:
// 0:rotation_x, 1:rotation_y, 2:rotation_z, 3:acceleration_x, 4:acceleration_y, 5:acceleration_z, 6:raindrop, 7:vibration, 8:soil20cm, 9:lstm_mse, 10:lstm_flag, 11:vae_mse, 12:vae_flag, 13:gru_trajectory_error

static const int16_t XGB_TREE_OFFSETS[151] = {
  0, 15, 30, 45, 60, 75, 90, 105, 120, 135, 150, 163, 178, 191, 206, 219,
  234, 249, 262, 277, 290, 305, 320, 333, 348, 361, 376, 389, 404, 419, 434, 447,
  462, 477, 490, 505, 518, 531, 544, 557, 570, 583, 596, 609, 622, 635, 648, 661,
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  1450, 1455, 1460, 1465, 1470, 1475, 1480,
};

static const int16_t XGB_LEFT[1480] = {
  1, 3, 5, 7, 9, 11, -1, -1, -1, -1, 13, -1, -1, -1, -1, 1, 3, 5, 7, 9,
  11, -1, -1, -1, -1, 13, -1, -1, -1, -1, 1, 3, 5, 7, 9, 11, -1, -1, -1, -1,
  13, -1, -1, -1, -1, 1, 3, 5, 7, 9, 11, -1, -1, -1, 13, -1, -1, -1, -1, -1,
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  1, 3, -1, -1, -1, 1, -1, 3, -1, -1, 1, 3, -1, -1, -1, 1, -1, 3, -1, -1,
};

static const int16_t XGB_RIGHT[1480] = {
  2, 4, 6, 8, 10, 12, -1, -1, -1, -1, 14, -1, -1, -1, -1, 2, 4, 6, 8, 10,
  12, -1, -1, -1, -1, 14, -1, -1, -1, -1, 2, 4, 6, 8, 10, 12, -1, -1, -1, -1,
  14, -1, -1, -1, -1, 2, 4, 6, 8, 10, 12, -1, -1, -1, 14, -1, -1, -1, -1, -1,
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  2, 4, -1, -1, -1, 2, -1, 4, -1, -1, 2, 4, -1, -1, -1, 2, -1, 4, -1, -1,
};

static const uint8_t XGB_SPLIT_FEATURE[1480] = {
  9, 1, 11, 0, 0, 0, 0, 0, 0, 0, 0, 0, 0, 0, 0, 9, 1, 11, 2, 0, 0, 0, 0, 0,
  0, 0, 0, 0, 0, 0, 9, 1, 11, 13, 0, 0, 0, 0, 0, 0, 0, 0, 0, 0, 0, 9, 1, 11,
  2, 1, 0, 0, 0, 0, 13, 0, 0, 0, 0, 0, 9, 1, 11, 13, 0, 0, 0, 0, 0, 0, 0, 0,
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  0, 1, 0, 13, 0, 0, 13, 3, 0, 0, 0, 1, 0, 3, 0, 0,
};

static const float XGB_SPLIT_CONDITION[1480] = {
  47.62005f, -0.68447316f, 56.3082f, -0.3106696f, -0.7046408f, -0.33236116f, 0.11382389f, 0.018703243f,
  0.08786112f, -0.026184538f, -0.22548318f, -0.07033364f, 0.09802775f, -0.087379895f, -0.026184538f, 47.62005f,
  -0.68447316f, 56.3082f, 0.25922117f, -0.7046408f, -0.33236116f, 0.10690186f, 0.08434638f, 0.017368512f,
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  0.017802723f, -0.018482897f, 0.01088571f, -0.68447316f, 0.01716764f, 5.2495246f, -0.017024174f, 0.008161678f,
};

static const float XGB_LEAF_WEIGHT[1480] = {
  -1.6098207e-08f, -1.5850704f, 2.0884562f, 1.5129151f, -1.7290576f, 0.5767413f, 0.11382389f, 0.018703243f,
  0.08786112f, -0.026184538f, -1.7382188f, -0.07033364f, 0.09802775f, -0.087379895f, -0.026184538f, -4.9792994e-05f,
  -1.5253149f, 1.9638934f, 1.4474576f, -1.6662534f, 0.549082f, 0.10690186f, 0.08434638f, 0.017368512f,
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  0.017802723f, -0.018482897f, 0.01088571f, 0.07223751f, 0.01716764f, -0.11879734f, -0.017024174f, 0.008161678f,
};


static inline float sigmoidStable(float x) {
  if (x >= 0.0f) {
    float e = expf(-x);
    return 1.0f / (1.0f + e);
  }
  float e = expf(x);
  return e / (1.0f + e);
}

bool runXGBEnsemble(const float features[XGB_ENSEMBLE_FEATURES], XGBEnsembleResult &result) {
  // XGBoost JSON base_score = 0.43333334 for binary:logistic.
  // XGBoost adds trees in margin/log-odds space and applies sigmoid at the end.
  float margin = -0.2682639594f;

  for (int t = 0; t < XGB_ENSEMBLE_TREES; ++t) {
    const int start = XGB_TREE_OFFSETS[t];
    const int end = XGB_TREE_OFFSETS[t + 1];
    int node = 0;

    while (true) {
      const int g = start + node;
      const int16_t lch = XGB_LEFT[g];

      if (lch < 0) {
        margin += XGB_LEAF_WEIGHT[g];
        break;
      }

      const uint8_t f = XGB_SPLIT_FEATURE[g];
      const float x = features[f];

      // The production inputs are finite. For completeness, missing/NaN
      // values follow XGBoost's default direction encoded by the JSON.
      if (isnan(x)) {
        node = XGB_RIGHT[g] >= 0 ? XGB_RIGHT[g] : XGB_LEFT[g];
      } else if (x < XGB_SPLIT_CONDITION[g]) {
        node = XGB_LEFT[g];
      } else {
        node = XGB_RIGHT[g];
      }

      if (node < 0 || start + node >= end) return false;
    }
  }

  result.margin = margin;
  result.probability = sigmoidStable(margin);
  result.prediction = (result.probability >= 0.5f);
  return true;
}

// ============================================================
// XGB TREE DEBUG
// ============================================================
//
// This performs the SAME traversal as runXGBEnsemble(),
// but prints every decision made by every tree.
//
// It is for diagnostic purposes only.
//
// ============================================================

void runXGBTreeDebug(
    const float features[XGB_ENSEMBLE_FEATURES]
)
{
    Serial.println();
    Serial.println("==============================================");
    Serial.println("          XGB TREE-BY-TREE DEBUG");
    Serial.println("==============================================");

    // --------------------------------------------------------
    // XGBoost base margin
    // --------------------------------------------------------

    float margin = -0.2682639594f;

    int totalLeaves = 0;

    // --------------------------------------------------------
    // Process all 150 trees
    // --------------------------------------------------------

    for (int t = 0; t < XGB_ENSEMBLE_TREES; ++t)
    {
        const int start = XGB_TREE_OFFSETS[t];
        const int end   = XGB_TREE_OFFSETS[t + 1];

        int node = 0;

        // ----------------------------------------------------
        // Traverse this tree
        // ----------------------------------------------------

        while (true)
        {
            const int g = start + node;

            const int16_t lch = XGB_LEFT[g];

            // ------------------------------------------------
            // LEAF NODE
            // ------------------------------------------------

            if (lch < 0)
            {
                const float leafWeight =
                    XGB_LEAF_WEIGHT[g];

                margin += leafWeight;

                Serial.printf(
                    "Tree %3d | GlobalNode %4d | "
                    "LeafWeight %+0.9f\n",
                    t,
                    g,
                    leafWeight
                );

                totalLeaves++;

                break;
            }

            // ------------------------------------------------
            // INTERNAL DECISION NODE
            // ------------------------------------------------

            const uint8_t feature =
                XGB_SPLIT_FEATURE[g];

            const float condition =
                XGB_SPLIT_CONDITION[g];

            const float value =
                features[feature];

            int nextNode;

            // ------------------------------------------------
            // NaN / missing value
            // ------------------------------------------------

            if (isnan(value))
            {
                if (XGB_RIGHT[g] >= 0)
                {
                    nextNode = XGB_RIGHT[g];
                }
                else
                {
                    nextNode = XGB_LEFT[g];
                }
            }

            // ------------------------------------------------
            // XGBoost split
            // ------------------------------------------------

            else if (value < condition)
            {
                nextNode = XGB_LEFT[g];
            }
            else
            {
                nextNode = XGB_RIGHT[g];
            }

            // ------------------------------------------------
            // Print decision
            // ------------------------------------------------

            Serial.printf(
                "Tree %3d | "
                "Node %4d | "
                "F=%2d | "
                "X=%+0.6f | "
                "Split=%+0.6f | "
                "Next=%d\n",

                t,
                g,
                feature,
                value,
                condition,
                nextNode
            );

            // ------------------------------------------------
            // Safety check
            // ------------------------------------------------

            if (nextNode < 0 ||
                start + nextNode >= end)
            {
                Serial.printf(
                    "ERROR: Invalid node in tree %d\n",
                    t
                );

                return;
            }

            node = nextNode;
        }
    }

    // ========================================================
    // FINAL RESULT
    // ========================================================

    const float probability =
        sigmoidStable(margin);

    Serial.println();
    Serial.println("----------------------------------------------");

    Serial.printf(
        "Trees processed   : %d\n",
        totalLeaves
    );

    Serial.printf(
        "Final Margin      : %.9f\n",
        margin
    );

    Serial.printf(
        "Final Probability : %.9f\n",
        probability
    );

    Serial.print("Final Class       : ");

    if (probability >= 0.5f)
    {
        Serial.println("1 / ANOMALY");
    }
    else
    {
        Serial.println("0 / NORMAL");
    }

    Serial.println("----------------------------------------------");
    Serial.println("==============================================");
}
